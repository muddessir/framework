## meta/yocto/conf/local.conf
```bitbake
# ----------
# Developer: Recai Almaz (muddessir@outlook.com)
#
# parametrelerin aciklamalari icin bknz: 
# https://www.yoctoproject.org/docs/current/ref-manual/ref-manual.html
# https://www.yoctoproject.org/docs/latest/mega-manual/mega-manual.html
#
# ----------

CONF_VERSION = "1"

# olusan imajin formatlari
IMAGE_FSTYPES += "wic wic.bmap ext4"

# sdk cross-compile toolchain ve poky sistemini olusturur.
SDKMACHINE ?= "x86_64"

# yocto derledigi butun kodlarin klasorlerini imaj disinda local bilgisayarda da bulunduruyor.
# bunlar cok yer kapladigi ve ihtiyacimiz olmadigi icin asagidaki rm_work silmemizi sagliyor.
INHERIT += "rm_work"

# root sifresi belirleme
INHERIT += "extrausers"
EXTRA_USERS_PARAMS_append = " usermod -P 1 root; useradd -P 1 ra; usermod -G sudo ra; "

# derlemeler ile ilgili istatistikler
USER_CLASSES ?= "image-mklibs image-prelink"

DL_DIR ?= "/opt/yocto/downloads"

MACHINE = "imx6qdlsabresd"

ACCEPT_FSL_EULA = "1"

DISTRO = "poky"

TOOLCHAIN_HOST_TASK_append = " nativesdk-packagegroup-sdk-host nativesdk-meson nativesdk-libtool"

TOOLCHAIN_TARGET_TASK_append = " target-sdk-provides-dummy gtkmm3 sqlite3 openssl cpprest curl curlpp mosquitto boost \
    libarchive gpsd nlohmann-json-dev lmsensors-dev alsa-lib alsa-dev gstreamer1.0-meta-base "

IMAGE_INSTALL_append = " qtbase bash coreutils dosfstools apt e2fsprogs file cpprest \
    nlohmann-json sqlite3 openssl curl libarchive gpsd gtkmm3 mosquitto "

# paket yonetim sistemi debian/deb
PACKAGE_CLASSES = "package_deb"

# diskin dolma ihtimaline karsi monitor gorevi gorur.
BB_DISKMON_DIRS ??= "\
    STOPTASKS,${TMPDIR},1G,100K \
    STOPTASKS,${DL_DIR},1G,100K \
    STOPTASKS,${SSTATE_DIR},1G,100K \
    STOPTASKS,/tmp,100M,100K \
    ABORT,${TMPDIR},100M,1K \
    ABORT,${DL_DIR},100M,1K \
    ABORT,${SSTATE_DIR},100M,1K \
    ABORT,/tmp,10M,1K"
    
SSTATE_MIRRORS ?= "file://.* http://sstate.yoctoproject.org/3.1.7/PATH;downloadfilename=PATH"
    
# thread sayisi normalde 12. fakat bilgisayarin rami 32/64gb degilse
# webkit gibi paketlerin derlemeleri hata veriyor. bu sebeple thread
# sayisi 4'e dusuruldu. eger bilgisayariniz 32/64gb ise bu miktari
# 12'ye yukselterek deneyebilirsiniz. hata alirsaniz iptal ediniz.
# https://github.com/Igalia/meta-webkit/discussions/178

BB_NUMBER_THREADS = "6"
PARALLEL_MAKE = "-j 6"
```
